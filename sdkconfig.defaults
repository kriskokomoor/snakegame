## sdkconfig.defaults
```kconfig
# FreeRTOS Configuration
# Arduino ESP32 requires CONFIG_FREERTOS_HZ=1000
CONFIG_FREERTOS_HZ=1000

# Bluetooth — required for Bluepad32/BTstack
# BT_CONTROLLER_ONLY: use ESP32 BT controller but no ESP host stack (BTstack is the host)
CONFIG_BT_ENABLED=y
CONFIG_BTDM_CTRL_MODE_BTDM=y
CONFIG_BT_CONTROLLER_ONLY=y

# Arduino autostart provides app_main → calls setup()/loop()
CONFIG_AUTOSTART_ARDUINO=y

# Bluepad32 platform — must be CUSTOM so uni_platform_set_custom() is accepted
CONFIG_BLUEPAD32_PLATFORM_CUSTOM=y

# Disable Bluepad32 UART REPL console — conflicts with Arduino Serial on UART0
CONFIG_BLUEPAD32_USB_CONSOLE_ENABLE=n

# Flash size configuration - Adjusting to 2MB to match hardware
CONFIG_ESPTOOLPY_FLASHSIZE_2MB=y
CONFIG_ESPTOOLPY_FLASHSIZE="2MB"
```
